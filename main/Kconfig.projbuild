## main/Kconfig.projbuild
```kconfig
menu "ESP32 Web Control Panel"

    config WEBCTRL_LED_GPIO
        int "Onboard LED GPIO number"
        range 0 39
        default 2
        help
            GPIO number (IOxx) driving the onboard plain LED (active high).

endmenu
```
